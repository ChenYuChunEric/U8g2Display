#include <Arduino.h>
#include <U8g2lib.h>
#include "DHT.h"
#define DHTPIN D5     // Digital pin connected to the DHT sensor
#define DHTTYPE DHT11   // DHT 11
DHT dht(DHTPIN, DHTTYPE);

#ifdef U8X8_HAVE_HW_SPI
#include <SPI.h>
#endif
#ifdef U8X8_HAVE_HW_I2C
#include <Wire.h>
#endif

// The complete list is available here: https://github.com/olikraus/u8g2/wiki/u8g2setupcpp

U8G2_SSD1306_128X64_NONAME_F_SW_I2C u8g2(U8G2_R0, /* clock=12*/ D2, /* data=13*/ D1, /* reset=*/ U8X8_PIN_NONE);   // All Boards without Reset of the Display

int button1 = D5;
int bitton2 = D6;
unsigned long int count = 0;

#define imgWidth 128
#define imgHeight 64

static const unsigned char PROGMEM logo_bmp[] =
{ 
0X00,0X00,0X00,0X00,0X00,0X00,0X00,0X00,0X00,0X00,0X00,0X00,0X00,0X00,0X00,0X00,
0X00,0X00,0X00,0X00,0X00,0X00,0X00,0X00,0X00,0X00,0X00,0X00,0X00,0X00,0X00,0X00,
0X00,0X00,0X00,0X00,0X00,0X00,0X00,0X00,0X00,0X00,0X00,0X00,0X00,0X00,0X00,0X00,
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0X00,0X00,0X00,0X00,0X00,0X00,0X00,0X00,0X00,0X00,0X00,0X00,0X00,0X00,0X00,0X00, };

static const unsigned char PROGMEM logo_bmp1[] =
{ 
0XFF,0XFF,0X00,0XF0,0XFF,0XFF,0XFF,0XFF,0XFF,0XFF,0XFF,0XFF,0XFF,0XFF,0XFF,0XFF,
0XFF,0X1F,0X00,0X80,0XFF,0XFF,0XFF,0XFF,0XFF,0XFF,0XFF,0XFF,0XFF,0XFF,0XFF,0XFF,
0XFF,0X07,0X00,0X00,0XFE,0XFF,0XFF,0XFF,0XFF,0XFF,0XFF,0XFF,0XFF,0XFF,0XFF,0XFF,
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0XF1,0XFF,0XFF,0XFF,0XFF,0XF8,0XFF,0XFF,0XFF,0XFF,0XFF,0XFF,0XFF,0XFF,0XFF,0XFF, };

static const unsigned char PROGMEM logo_bmp2[] =
{ 
0X00,0X00,0X00,0X00,0X00,0X00,0X00,0X00,0X00,0X00,0X00,0X00,0X00,0X00,0X00,0X00,
0X00,0X00,0X00,0X00,0X00,0X00,0X00,0X00,0X00,0X00,0X00,0X00,0X00,0X00,0X00,0X00,
0X00,0X00,0X00,0XE0,0XFF,0X00,0X00,0X00,0X00,0X00,0X80,0XFF,0X01,0X00,0X00,0X00,
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0X00,0X00,0X00,0X00,0X00,0X00,0X00,0X00,0X00,0X00,0X00,0X00,0X00,0X00,0X00,0X00, };

void setup(void) {
  dht.begin();
  u8g2.begin();
  u8g2.enableUTF8Print();
  Serial.begin(115200);
  pinMode(D6,INPUT);
  pinMode(D7,INPUT);
}

void loop(void) {
  float h = dht.readHumidity();
  float t = dht.readTemperature();
  Serial.println(t);
  Serial.println(h);

  String OutputH = String("H:") + h + "%";
  String OutputT = String("T:") + t + (char)223 +"C";
  
  if(digitalRead(D6) == HIGH){
    count++;
    Serial.println(count);
    delay(50);
  }
  if(digitalRead(D7) == HIGH){
    count--;
    Serial.println(count);
    delay(50);
  }
  if(count%4 == 0){
    u8g2.firstPage();
    do {
      u8g2.setFont(u8g2_font_unifont_t_chinese1);
      u8g2.setCursor(0, 16);
      u8g2.print("北鼻抱抱啾");
      u8g2.drawXBMP(64,32, imgWidth, imgHeight, logo_bmp);  //繪圖
    } while ( u8g2.nextPage() );
  }
  if(count%4 == 1){
    u8g2.firstPage();
    do {
      //u8g2.setCursor(0, 16);
      //u8g2.print("I am Sorry");
      u8g2.drawXBMP(0,4, imgWidth, imgHeight, logo_bmp1);  //繪圖
    } while ( u8g2.nextPage() );
  }
  if(count%4 == 2){
    u8g2.firstPage();
    do {
      //u8g2.setCursor(0, 16);
      //u8g2.print("愛心");
      u8g2.drawXBMP(0,4, imgWidth, imgHeight, logo_bmp2);  //繪圖
    } while ( u8g2.nextPage() );
  }
  if(count%4 == 3){
    //u8g2.firstPage();
    //do {
      u8g2.clearBuffer();          // clear the internal memory
      //u8g2.setFont(u8g2_font_unifont_t_chinese1);
      u8g2.setFont(u8g2_font_ncenB08_tr); // choose a suitable font
      //u8g2.drawStr(0,16,"我好帥123");  // write something to the internal memory
      u8g2.setCursor(0, 16);
      u8g2.print(OutputH);
      u8g2.setCursor(0, 32);
      u8g2.print(OutputT);
      u8g2.sendBuffer();          // transfer internal memory to the display
    //} while ( u8g2.nextPage() );
  }
}
